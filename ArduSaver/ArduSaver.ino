//----------------------------------------------------------------------------
// ARDUBOY SCREENSAVER
// 2019 Bert vt Veer
//----------------------------------------------------------------------------

#include <Arduboy2.h>
Arduboy2 ardu;
#define ARDBITMAP_SBUF ardu.getBuffer()
#include <ArdBitmap.h>
ArdBitmap<WIDTH, HEIGHT> ardbitmap;

const int NUM_OBJECTS = 16;
uint8_t timeout = 1;
uint32_t timer = 0;

bool menu_state = false;
bool button_state = false;


const unsigned char PROGMEM img_winlogo[] = { // 81, 64,
    0x00, 0x00, 0x00, 0x60, 0x60, 0x00, 0x00, 0x00, 0x00, 0x80, 0x80, 0x00, 0x00, 0x00, 0x00, 0x00, 0x00, 0x00, 0x00, 0x00, 0x00, 0x00, 0x00,
    0x00, 0x00, 0x00, 0x00, 0x00, 0x00, 0x00, 0x00, 0x00, 0x00, 0x00, 0x00, 0x00, 0x00, 0x80, 0x80, 0xc0, 0xc0, 0x00, 0x00, 0xf0, 0xf0, 0xf0,
    0xf8, 0xf8, 0xf8, 0xfc, 0xfc, 0xfc, 0xfc, 0xfe, 0xfe, 0xfe, 0xfe, 0xfe, 0xff, 0x7f, 0x7f, 0x7f, 0x7f, 0x7e, 0x7e, 0x7e, 0x7e, 0x7e, 0xfc, 
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    0x00, 0x01, 0x00, 0x00
};

const unsigned char PROGMEM img_button[] =
{
    49, 19,
    0xfe, 0x03, 0x05, 0xa9, 0x01, 0x09, 0x01, 0x09, 0x01, 0x09, 0x01, 0x09, 0x41, 0x49, 0xc1, 0xc9, 0x41, 0x49, 0x01, 0xc9, 0xc1, 0x49, 0x41,
    0x49, 0x01, 0x89, 0xc1, 0x49, 0x41, 0xc9, 0x81, 0x09, 0x41, 0x49, 0xc1, 0xc9, 0x41, 0x49, 0x01, 0x09, 0x01, 0x09, 0x01, 0x09, 0x01, 0x09, 
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    0x05, 0x06, 0x05, 0x06, 0x05, 0x06, 0x05, 0x06, 0x03 
};

const unsigned char PROGMEM img_button_down[] =
{
    49, 19,
    0xfe, 0xab, 0x55, 0x03, 0x05, 0x03, 0x05, 0x03, 0x05, 0x03, 0x05, 0x03, 0x85, 0x83, 0x85, 0x83, 0x85, 0x83, 0x05, 0x83, 0x85, 0x83, 0x85, 
    0x83, 0x05, 0x03, 0x85, 0x83, 0x85, 0x83, 0x05, 0x03, 0x85, 0x83, 0x85, 0x83, 0x85, 0x83, 0x05, 0x03, 0x05, 0x03, 0x05, 0x03, 0x05, 0x03, 
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    0x04, 0x04, 0x04, 0x04, 0x04, 0x04, 0x04, 0x06, 0x03
};

const unsigned char PROGMEM img_title[] =
{
    82, 9,
    0x00, 0x00, 0x00, 0x8e, 0x9f, 0x11, 0x11, 0xf3, 0xe2, 0x00, 0x00, 0xf0, 0xf8, 0x08, 0x08, 0x98, 0x90, 0x00, 0xf8, 0xf8, 0x08, 0x00, 0xf0,
    0xf8, 0x28, 0x28, 0xb8, 0xb0, 0x00, 0xf0, 0xf8, 0x28, 0x28, 0xb8, 0xb0, 0x00, 0xf8, 0xf8, 0x18, 0x08, 0xf8, 0xf0, 0x00, 0x00, 0x00, 0x00, 
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    0x00, 0x00, 0x00
};

const unsigned char PROGMEM img_delay[] =
{
    102, 17,
    0x00, 0xf0, 0xf0, 0x10, 0x10, 0x30, 0xe0, 0xc0, 0x00, 0x00, 0x00, 0x80, 0x80, 0x80, 0x80, 0x00, 0x00, 0xf0, 0xf0, 0x00, 0x00, 0x80, 0x80, 
    0x80, 0x80, 0x00, 0x00, 0x80, 0x80, 0x00, 0x80, 0x80, 0x00, 0x80, 0x80, 0x00, 0x00, 0x00, 0x00, 0x00, 0x00, 0x00, 0xff, 0x01, 0x01, 0x01, 
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    0x00, 0x00, 0x00, 0x00, 0x00, 0x00, 0x00 
};


template <typename T> T rnd(T upper) {
    return static_cast<T>(rand()) / static_cast<T>(RAND_MAX/upper);
}

struct s_object 
{
    float x;
    float y;
    float dx;
    float dy;
    float scale;
    float speed;
    
    s_object() { 
        reset(); 
    } 
    void reset() {
         x = 0;
         y = 0;
         scale = 0.02f;
         speed = 1.02f + rnd(0.05f);
         dx = (-0.5f + rnd(1.0f));
         dy = (-0.5f + rnd(1.0f));
    } 
    void update() {
        x += dx;
        y += dy;
        scale *= speed;
        dx *= speed;
        dy *= speed;
        if (scale>1.0 || x<-64 || x>64 || y<-32 || y>32) reset();
    }
} 
objects[NUM_OBJECTS];


void drawScreen() {
    if (menu_state) {
        ardu.invert(true);
        ardu.fillScreen(BLACK);
        ardu.drawRect(2,2, 124, 60);
        Sprites::drawOverwrite(12,1, img_title, 0);
        Sprites::drawSelfMasked(12,17, img_delay, 0);
        Sprites::drawSelfMasked(12,40, button_state ? img_button_down : img_button, 0);
        ardu.setCursor(58, 22); ardu.print(timeout);
    }
    else {
        ardu.invert(false);
        ardu.fillScreen(BLACK);
        for (int n=0; n<NUM_OBJECTS; n++) {
            s_object& obj = objects[n];
            if (obj.scale < 0.04) ardu.drawPixel((uint16_t)(64+obj.x), (uint16_t)(32+obj.y), WHITE);
            else if (obj.scale < 0.06) ardu.fillRect((uint16_t)(64+obj.x), (uint16_t)(32+obj.y), 2,2, WHITE);
            else ardbitmap.drawBitmapResized((uint16_t)(64+obj.x), (uint16_t)(32+obj.y), img_winlogo, 81,64, 1, ALIGN_CENTER, 0, obj.scale);
            obj.update();
        }
    }
}

void setup() 
{
    ardu.begin();
    ardu.setFrameRate(30);
    ardu.initRandomSeed();
}


void setTimer() {
    timer = millis() + timeout * 60000;  
}

void loop()
{
    if (ardu.nextFrame()) {
        ardu.pollButtons();
        
        if (menu_state) {   
            if (ardu.buttonsState()) setTimer();
            else if (millis() > timer) menu_state = false;

            if (ardu.justPressed(UP_BUTTON)) { 
                if (timeout < 30) timeout++;
            }
            if (ardu.justPressed(DOWN_BUTTON)) { 
                if (timeout > 1) timeout--; 
            }
            if (ardu.justPressed(A_BUTTON)) { 
                button_state = true; 
            }
            if (ardu.justReleased(A_BUTTON) && button_state) { 
                menu_state = false;   
                button_state = false;   
            }
        }
        else {
            if (ardu.buttonsState()) {
                menu_state = true;  
                setTimer();       
            }
        }
        drawScreen();    
        ardu.display();
        ardu.idle();
    }
}
